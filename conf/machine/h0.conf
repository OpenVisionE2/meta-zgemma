## conf/machine/h0.conf
```bitbake
#@TYPE: Machine
#@NAME: h0
#@DESCRIPTION: Machine configuration for the h0

require conf/machine/include/zgemma-hisil-3716mv430.inc

MACHINE_FEATURES += "ciplus-helper ci"

MACHINETYPE = "hzero"
```

## conf/machine/h10.conf
```bitbake
#@TYPE: Machine
#@NAME: h10
#@DESCRIPTION: Machine configuration for the h10

MACHINE_FEATURES += "textlcd 7segment blindscan-dvbs hisil-recovery ci bluetooth mountboot ciplus-helper"

IMAGE_CLASSES += "zgemma-fastboot8gb_image"
IMAGE_FSTYPES += "zgemmafastboot8gb tar"

RCTYPE = "28"
RCNAME = "zgemma7"

require conf/machine/include/zgemma-hisil-3798mv200.inc

MTD_BOOTFS = "mmcblk0p4"
MTD_ROOTFS = "mmcblk0p23"
MTD_KERNEL = "mmcblk0p19"
KERNEL_FILE = "uImage"
ROOTFS_FILE = "rootfs.tar.bz2"
MTD_BLACK  = "mmcblk0"

MACHINE_ESSENTIAL_EXTRA_RDEPENDS += "\
	kernel-module-extrawlan-rt8822bu \
	"
```

## conf/machine/h6.conf
```bitbake
#@TYPE: Machine
#@NAME: h6
#@DESCRIPTION: Machine configuration for h6

MKUBIFS_ARGS = "-m 2048 -e 126976 -c 8192"
UBINIZE_ARGS = "-m 2048 -p 128KiB"

MACHINE_FEATURES += "textlcd 7segment h265 ci RCA"

SOC_FAMILY = "bcm73625"
RCTYPE = "21"

require conf/machine/include/zgemma-mipsel.inc
```

## conf/machine/h7.conf
```bitbake
#@TYPE: Machine
#@NAME: h7
#@DESCRIPTION: Machine configuration for the h7

require conf/machine/include/zgemma-cortex-a15.inc
```

## conf/machine/h8.conf
```bitbake
#@TYPE: Machine
#@NAME: h8
#@DESCRIPTION: Machine configuration for the h8

require conf/machine/include/zgemma-hisil-3716mv430.inc

MACHINE_FEATURES += "dvb-c"
```

## conf/machine/h9.conf
```bitbake
#@TYPE: Machine
#@NAME: h9
#@DESCRIPTION: Machine configuration for the h9

MACHINE_FEATURES += "blindscan-dvbs ci SDcard"

IMAGE_FSTYPES += "ubi"
MKUBIFS_ARGS = "-m 2048 -e 126976 -c 8192"
UBINIZE_ARGS = "-m 2048 -p 128KiB"

MTD_KERNEL = "mtd6"
MTD_ROOTFS = "mtd7"
KERNEL_FILE = "uImage"
ROOTFS_FILE = "rootfs.ubi"

RCTYPE = "28"
RCNAME = "zgemma6"

require conf/machine/include/zgemma-hisil-3798mv200.inc
```

## conf/machine/h9combo.conf
```bitbake
#@TYPE: Machine
#@NAME: h9combo
#@DESCRIPTION: Machine configuration for the h9combo

MACHINE_FEATURES += "textlcd 7segment blindscan-dvbs hisil-recovery mountboot ci ciplus-helper"

IMAGE_CLASSES += "zgemma-fastboot8gb_image"
IMAGE_FSTYPES += "zgemmafastboot8gb tar"

RCTYPE = "28"

require conf/machine/include/zgemma-hisil-3798mv200.inc

MTD_BOOTFS = "mmcblk0p4"
MTD_ROOTFS = "mmcblk0p23"
MTD_KERNEL = "mmcblk0p19"
KERNEL_FILE = "uImage"
ROOTFS_FILE = "rootfs.tar.bz2"
MTD_BLACK  = "mmcblk0"
```

## conf/machine/h9combose.conf
```bitbake
#@TYPE: Machine
#@NAME: h9combose
#@DESCRIPTION: Machine configuration for the h9combose

MACHINE_FEATURES += "textlcd 7segment blindscan-dvbs hisil-recovery ci ciplus-helper mountboot"

IMAGE_CLASSES += "zgemma-fastboot8gb_image"
IMAGE_FSTYPES += "zgemmafastboot8gb tar"

RCTYPE = "28"

require conf/machine/include/zgemma-hisil-3798mv200.inc

MTD_BOOTFS = "mmcblk0p4"
MTD_ROOTFS = "mmcblk0p23"
MTD_KERNEL = "mmcblk0p19"
KERNEL_FILE = "uImage"
ROOTFS_FILE = "rootfs.tar.bz2"
MTD_BLACK  = "mmcblk0"
```

## conf/machine/h9se.conf
```bitbake
#@TYPE: Machine
#@NAME: h9se
#@DESCRIPTION: Machine configuration for the h9se

MACHINE_FEATURES += "blindscan-dvbs ci hisil-recovery mountboot"

IMAGE_CLASSES += "zgemma-fastboot8gb_image"
IMAGE_FSTYPES += "zgemmafastboot8gb tar"

RCTYPE = "28"

require conf/machine/include/zgemma-hisil-3798mv200.inc

MTD_BOOTFS = "mmcblk0p4"
MTD_ROOTFS = "mmcblk0p23"
MTD_KERNEL = "mmcblk0p19"
KERNEL_FILE = "uImage"
ROOTFS_FILE = "rootfs.tar.bz2"
MTD_BLACK  = "mmcblk0"
```

## conf/machine/i55.conf
```bitbake
#@TYPE: Machine
#@NAME: i55
#@DESCRIPTION: Machine configuration for i55

MKUBIFS_ARGS = "-m 2048 -e 126976 -c 8192"
UBINIZE_ARGS = "-m 2048 -p 128KiB"

SOC_FAMILY = "bcm7362"

RCTYPE = "22"
RCNAME = "zgemma5"

FORCE = "yes"

require conf/machine/include/zgemma-mipsel.inc

MACHINE_FEATURES += "satip gbipboxclient"
```

## conf/machine/i55plus.conf
```bitbake
#@TYPE: Machine
#@NAME: i55plus
#@DESCRIPTION: Machine configuration for the i55plus

MACHINE_FEATURES += "SDcard gbipboxclient"

IMAGE_FSTYPES += "ubi"
MKUBIFS_ARGS = "-m 2048 -e 126976 -c 8192"
UBINIZE_ARGS = "-m 2048 -p 128KiB"

MTD_KERNEL = "mtd6"
MTD_ROOTFS = "mtd7"
KERNEL_FILE = "uImage"
ROOTFS_FILE = "rootfs.ubi"

RCTYPE = "25"

require conf/machine/include/zgemma-hisil-3798mv200.inc
```

## conf/machine/i55plusse.conf
```bitbake
#@TYPE: Machine
#@NAME: i55plusse
#@DESCRIPTION: Machine configuration for the i55plusse

MACHINE_FEATURES += "ci hisil-recovery mountboot gbipboxclient"

IMAGE_CLASSES += "zgemma-fastboot8gb_image"
IMAGE_FSTYPES += "zgemmafastboot8gb tar"

RCTYPE = "28"

require conf/machine/include/zgemma-hisil-3798mv200.inc

MTD_BOOTFS = "mmcblk0p4"
MTD_ROOTFS = "mmcblk0p23"
MTD_KERNEL = "mmcblk0p19"
KERNEL_FILE = "uImage"
ROOTFS_FILE = "rootfs.tar.bz2"
MTD_BLACK  = "mmcblk0"

MACHINETYPE = "i55se"
```

## conf/machine/include/zgemma-cortex-a15.inc
```bitbake
# We know about rtc
MACHINE_FEATURES_BACKFILL_CONSIDERED += "rtc"

KERNELVERSION = "4.10.12"

TARGET_ARCH = "arm"
DEFAULTTUNE = "cortexa15hf-neon-vfpv4"

IMAGE_CLASSES += "zgemma-emmc_image_multiboot"
IMAGE_FSTYPES += "zgemmc tar"
IMAGE_ROOTFS_SIZE ?= "589824"

SOC_FAMILY = "bcm7251s"
RCTYPE = "28"

MTD_BOOTFS = "mmcblk0p1"
MTD_ROOTFS = "mmcblk0p3"
MTD_KERNEL = "mmcblk0p2"
KERNEL_FILE = "kernel.bin"
ROOTFS_FILE = "rootfs.tar.bz2"
MTD_BLACK  = "mmcblk0"

#Provider
PREFERRED_PROVIDER_virtual/kernel = "linux-zgemma"
PREFERRED_VERSION_linux-zgemma = "${KERNELVERSION}"
PREFERRED_PROVIDER_virtual/libgl ?= "mesa"
PREFERRED_PROVIDER_virtual/mesa ?= "mesa"
PREFERRED_PROVIDER_virtual/blindscan-dvbc = "zgemma-dvb-modules-${MACHINE}"
PREFERRED_PROVIDER_virtual/blindscan-dvbs = "zgemma-dvb-modules-${MACHINE}"

require conf/machine/include/tune-cortexa15.inc
require conf/machine/include/zgemma-essential.inc

MACHINE_ESSENTIAL_EXTRA_RDEPENDS += "\
	gstreamer1.0-plugin-dvbmediasink \
	${@bb.utils.contains('MACHINE_FEATURES', 'swap', 'zgemma-swapcreate', '',d)} \
	"

DVBMEDIASINK_CONFIG = "--with-wma --with-wmv --with-pcm --with-dts --with-eac3 --with-h265 --with-vb6 --with-vb8 --with-vb9 --with-spark"

MACHINE_FEATURES += "alsa usbhost switchoff osdposition hdmicec blindscan-tbs textlcd 7segment dvb-c v3d-nxpl emmc ci mountboot blindscan-dvbs swap AV_JACK HDMI"

IMAGE_CMD_prepend = "\
	rm -Rf ${IMAGE_ROOTFS}/tmp/*; \
	"

IMAGE_CMD_zgemmc_append = " \
	mkdir -p ${IMGDEPLOYDIR}/${IMAGEDIR}; \
	cp -f ${IMGDEPLOYDIR}/${IMAGE_NAME}.emmc.img ${IMGDEPLOYDIR}/${IMAGEDIR}/disk.img; \
	echo "${IMAGE_NAME}" > ${IMGDEPLOYDIR}/${IMAGEDIR}/imageversion; \
	echo "https://forum.openvision.tech/app.php/donate" > ${IMGDEPLOYDIR}/${IMAGEDIR}/donate.txt; \
	cp -f ${DEPLOY_DIR_IMAGE}/zImage ${IMGDEPLOYDIR}/${IMAGEDIR}/${KERNEL_FILE}; \
	cp -f ${IMGDEPLOYDIR}/${IMAGE_NAME}${IMAGE_NAME_SUFFIX}.tar ${IMGDEPLOYDIR}/${IMAGEDIR}/rootfs.tar; \
	bzip2 ${IMGDEPLOYDIR}/${IMAGEDIR}/rootfs.tar; \
	rm -f ${IMGDEPLOYDIR}/*.zip; \
	cd ${IMGDEPLOYDIR}; \
	zip ${IMAGE_NAME}_recovery_emmc.zip ${IMAGEDIR}/disk.img ${IMAGEDIR}/imageversion ${IMAGEDIR}/donate.txt; \
	zip ${IMAGE_NAME}_usb.zip ${IMAGEDIR}/imageversion ${IMAGEDIR}/donate.txt ${IMAGEDIR}/${KERNEL_FILE} ${IMAGEDIR}/${ROOTFS_FILE}; \
	rm -f ${DEPLOY_DIR_IMAGE}/*.tar.bz2; \
	rm -Rf ${IMAGEDIR}; \
	rm -Rf zgemma; \
	"
```

## conf/machine/include/zgemma-essential.inc
```bitbake
DISTRO_FEATURES_remove += "x11 wayland directfb"

MACHINE_ESSENTIAL_EXTRA_RDEPENDS += "\
	zgemma-dvb-modules-${MACHINE} \
	${@bb.utils.contains("MACHINE_FEATURES", "emmc", "zgemma-resizerootfs partitions-by-name" , "", d)} \
	${@bb.utils.contains("MACHINE_FEATURES", "bluetooth", "kernel-module-btusb bluez5" , "", d)} \
	"

BOX_BRAND = "airdigital"

IMAGEDIR ?= "zgemma/${MACHINE}"

RCNAME ?= "zgemma3"
RCIDNUM ?= "1"
```

## conf/machine/include/zgemma-hisil-3716mv430.inc
```bitbake
IMAGEDIR = "${MACHINETYPE}"

KERNELVERSION = "4.4.35"

# We know about rtc
MACHINE_FEATURES_BACKFILL_CONSIDERED += "rtc"

TARGET_ARCH = "arm"
DEFAULTTUNE = "cortexa7hf"

SOC_FAMILY = "hisi3716mv430"
HICHIPSET = "3716mv430"
CHIPSET = "Hi3716Mv430"

STB_PLATFORM = "zgemmahisi3716mv430"

IMAGE_CLASSES += "zgemma-ubi_image"
IMAGE_FSTYPES += "ubi zgemmaubi"

MKUBIFS_ARGS = "-m 4096 -e 253952 -c 2048"
UBINIZE_ARGS = "-m 4096 -p 256KiB -s 4096"

CMDLINE ?= "console=ttyAMA0,115200n8"

MTD_KERNEL = "mtd9"
MTD_ROOTFS = "mtd10"
KERNEL_FILE = "uImage"
ROOTFS_FILE = "rootfs.ubi"

RCTYPE = "25"

#Provider
PREFERRED_PROVIDER_virtual/kernel = "linux-zgemma"
PREFERRED_VERSION_linux-zgemma = "${KERNELVERSION}"
PREFERRED_PROVIDER_virtual/gstreamer1.0-dvbmediasink = "gstreamer1.0-plugin-dvbmediasink"
PREFERRED_PROVIDER_virtual/enigma2-mediaservice = "enigma2-plugin-systemplugins-servicehisilicon"

require conf/machine/include/tune-cortexa7.inc
require conf/machine/include/zgemma-essential.inc

# E2 OSD settings
EXTRA_OECONF_append_pn-enigma2 = " --with-alphablendingacceleration=always --with-blitaccelerationthreshold=250 --with-fillaccelerationthreshold=190000"

# Gstreamer dvbmediasink
DVBMEDIASINK_CONFIG = "--with-wma --with-wmv --with-pcm --with-dts --with-eac3 --with-h265 --with-vb6 --with-vb8 -with-spark"

MACHINE_FEATURES += "alsa usbhost switchoff osdposition hdmicec no-opengl hisil hisil-3716mv430 blindscan-tbs HDMI wol"

MACHINE_ESSENTIAL_EXTRA_RDEPENDS += "\
	${@bb.utils.contains("MACHINE_FEATURES", "hisil-${HICHIPSET}", "zgemma-libs-${HICHIPSET} zgemma-param-${HICHIPSET} zgemma-bootargs-${HICHIPSET} zgemma-bootlogo-${HICHIPSET} zgemma-fastboot-${HICHIPSET}" , "", d)} \
	${@bb.utils.contains("MACHINE_FEATURES", "wol", "zgemma-ethwol" , "", d)} \
	${@bb.utils.contains("MACHINE_FEATURES", "ciplus-helper", "ciplus-helper-${HICHIPSET}" , "", d)} \
	firmware-rtl8192eu \
	kernel-module-extrawlan-rtl8192eu \
	firmware-mt7601u \
	kernel-module-mt7601u \
	kernel-module-extrawlan-rtl8192fu \
	"

IMAGE_CMD_ubifs_prepend = " \
	rm -Rf ${IMAGE_ROOTFS}/tmp/*; \
	"

IMAGE_CMD_ubi_append = " \
	mkdir -p ${IMGDEPLOYDIR}/zgemma/${IMAGEDIR}; \
	cp -f ${IMGDEPLOYDIR}/${IMAGE_NAME}${IMAGE_NAME_SUFFIX}.ubi ${IMGDEPLOYDIR}/zgemma/${IMAGEDIR}/${ROOTFS_FILE}; \
	cp -f ${DEPLOY_DIR_IMAGE}/uImage ${IMGDEPLOYDIR}/zgemma/${IMAGEDIR}/${KERNEL_FILE}; \
	cp -f ${IMGDEPLOYDIR}/bootoptions.img ${IMGDEPLOYDIR}/zgemma/${IMAGEDIR}/bootoptions.img; \
	cp -f ${DEPLOY_DIR_IMAGE}/zgemma-partitions-${MACHINE}/update_bootargs_${MACHINE}.bin ${IMGDEPLOYDIR}/zgemma/update_bootargs_${MACHINE}.bin; \
	cp -f ${DEPLOY_DIR_IMAGE}/zgemma-partitions-${MACHINE}/${MACHINE}/fastboot.bin ${IMGDEPLOYDIR}/zgemma/${IMAGEDIR}/fastboot.bin; \
	cp -f ${DEPLOY_DIR_IMAGE}/zgemma-partitions-${MACHINE}/${MACHINE}/bootargs.bin ${IMGDEPLOYDIR}/zgemma/${IMAGEDIR}/bootargs.bin; \
	cp -f ${DEPLOY_DIR_IMAGE}/zgemma-partitions-${MACHINE}/${MACHINE}/pq_param.bin ${IMGDEPLOYDIR}/zgemma/${IMAGEDIR}/pq_param.bin; \
	cp -f ${DEPLOY_DIR_IMAGE}/zgemma-partitions-${MACHINE}/${MACHINE}/baseparam.img ${IMGDEPLOYDIR}/zgemma/${IMAGEDIR}/baseparam.img; \
	cp -f ${DEPLOY_DIR_IMAGE}/zgemma-partitions-${MACHINE}/${MACHINE}/logo.img ${IMGDEPLOYDIR}/zgemma/${IMAGEDIR}/logo.img; \
	echo "${IMAGE_NAME}" > ${IMGDEPLOYDIR}/zgemma/imageversion; \
	echo "https://forum.openvision.tech/app.php/donate" > ${IMGDEPLOYDIR}/zgemma/donate.txt; \
	cd ${IMGDEPLOYDIR}/zgemma; \
	zip -r ../${IMAGE_NAME}_usb.zip *; \
	cd ..; \
	rm -f ${DEPLOY_DIR_IMAGE}/*.ubi; \
	rm -f ${DEPLOY_DIR_IMAGE}/*.ubifs; \
	rm -Rf zgemma; \
	rm -Rf ${DEPLOY_DIR_IMAGE}/zgemma-partitions-${MACHINE}; \
	"
```
